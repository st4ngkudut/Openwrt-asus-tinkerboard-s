
/dts-v1/;
#include "rk3288.dtsi"
#include "rk3288-miniarm.dtsi"

/ {
    model = "Rockchip RK3288 Tinker Board";
    compatible = "rockchip,rk3288-tinker", "rockchip,rk3288";

    memory@0 {
        device_type = "memory";
        reg = <0x0 0x80000000>;
    };

    aliases {
        ethernet0 = &gmac;
        serial0 = &uart2;
    };

    chosen {
        bootargs = "console=ttyS2,115200n8 root=/dev/mmcblk0p2 rootwait";
    };
};
